## main/Kconfig.projbuild
```kconfig
# put here your custom config value
menu "KP-PTR Configuration"
	config KPPTR_FIRMWARE_VER
	    string "KP-PTR firmware version"
	    default "v0.1"
	    help
			Version of the current firmware.
			
	choice KPPTR_HW
        prompt "KP-PTR HW version"
        default BOARD_KPPTR_VER_1_REV_0
        help
            Select hardware version and revision.

        config BOARD_KPPTR_VER_0_REV_1
            bool "Version 0 revision 1"
        config BOARD_KPPTR_VER_1_REV_0
            bool "Version 1 revision 0"
        config BOARD_ARECORDER_VER_3_REV_0
        	bool "Arecorder v3.0"
    endchoice
    
    choice KPPTR_FS
        prompt "File system for data logging"
        default FS_SIMPLEFS
        help
            Select file system to be used in data logging. Default is SimpleFS - custom simplified file system.

        config FS_SIMPLEFS
            bool "SimpleFS"
        config FS_LITTLEFS
            bool "LittleFS"
        config FS_SPIFFS
            bool "SPIFFS"
    endchoice
			
	config ESP_WIFI_SSID
	    string "WiFi SSID"
	    default "myssid"
	    help
			SSID (network name) for the example to connect to.
	
	config ESP_WIFI_PASSWORD
	    string "WiFi Password"
	    default "mypassword"
	    help
			WiFi password (WPA or WPA2) for the example to use.
		
	config KPPTR_MEAS_RATE_HZ
	    int "KP-PTR measuremnt rate in Hz"
	    range 10 1000
	    default "100"
	    help
			Sensors update rate in Hz.
	
	config KPPTR_TELEMETRY_DUTYCYCLE_PRECENTAGE
	    int "KP-PTR telemetry duty cycle in %"
	    range 1 100
	    default "20"
	    help
			Telemetry send duty cycle in %. Equivalent to RF band ocupation.
		
	config KPPTR_LOG_RATE_HZ
	    int "KP-PTR logging rate in Hz"
	    range 1 1000
	    default 1
	    help
			Logging rate in Hz.
	
    config KPPTR_MASTERKEY
        int "KP-PTR master key"
        range 1 10000000
        default 1
        help
            Master key used for device managment
        
	choice KPPTR_LOG_DEVICE
        prompt "KP-PTR logging device"
        default KPPTR_LOG_DEVICE_FLASH
        help
            Select storage (uSD, Flash, None).

        config KPPTR_LOG_DEVICE_FLASH
            bool "Flash"
        config KPPTR_LOG_DEVICE_USD
            bool "uSD"
        config KPPTR_LOG_DEVICE_NONE
			bool "None"
    endchoice
    
    config KPPTR_SENSOR_EN_LSM
    	bool "Enable LSM acc+gyro sensor"
    	default 0
    	help
    		Check if you want use LSM acc+gyro sensor.
    
    config KPPTR_SENSOR_EN_LIS
    	bool "Enable H3LIS331 high G sensor"
    	default 0
    	help
    		Check if you want use H3LIS331 high G sensor.
    
    config KPPTR_SENSOR_EN_MMC
    	bool "Enable MMC5983 magnetic sensor"
    	default 0
    	help
    		Check if you want use MMC5983 magnetic sensor.
    		
    config KPPTR_SENSOR_EN_GNSS
    	bool "Enable GNSS receiver"
    	default 0
    	help
    		Check if you want use GNSS receiver.
	
endmenu


menu "GNSS Configuration"


    config NMEA_PARSER_RING_BUFFER_SIZE
        int "NMEA Parser Ring Buffer Size"
        range 0 2048
        default 1024
        help
            Size of the ring buffer used for UART Rx channel.

    config NMEA_PARSER_TASK_STACK_SIZE
        int "NMEA Parser Task Stack Size"
        range 0 4096
        default 2048
        help
            Stack size of NMEA Parser task.

    config NMEA_PARSER_TASK_PRIORITY
        int "NMEA Parser Task Priority"
        range 0 24
        default 2
        help
            Priority of NMEA Parser task.

	menu "NMEA Statement Support"
        comment "At least one statement must be selected"
        config NMEA_STATEMENT_GGA
            bool "GGA Statement"
            default y
            help
                Enabling this option will parse the following parameter from GGA statement:

                - Latitude, Longitude, Altitude;
                - Number of satellites in use, fix status (no fix, GPS, DGPS), UTC time;

        config NMEA_STATEMENT_GSA
            bool "GSA Statement"
            default y
            help
                Enabling this option will parse the following parameter from GSA statement:

                - Position/Vertical/Horizontal dilution of precision;
                - Fix mode (no fix, 2D, 3D fix);
                - IDs of satellites in use;

        config NMEA_STATEMENT_GSV
            bool "GSV Statement"
            default y
            help
                Enabling this option will parse the following parameter from GSV statement:

                - Number of satellites in view;
                - Optional details of each satellite in view;

        config NMEA_STATEMENT_RMC
            bool "RMC Statement"
            default y
            help
                Enabling this option will parse the following parameter from RMC statement:

                - Validity of GPS signal;
                - Ground speed (knots) and course over ground (degrees);
                - Magnetic variation;
                - UTC date;

        config NMEA_STATEMENT_GLL
            bool "GLL Statement"
            default y
            help
                Enabling this option will parse the following parameter from GLL statement:

                - Latitude, Longitude;
                - UTC time;

        config NMEA_STATEMENT_VTG
            bool "VTG Statement"
            default y
            help
                Enabling this option will parse the following parameter from VTG statement:

                - Ground speed (knots, km/h) and course over ground (degrees);
                - Magnetic variation;

	endmenu

endmenu
```
